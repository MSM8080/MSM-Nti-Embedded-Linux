## meta-msm/conf/distro/include/hw-variant-cfg.inc
```bitbake
ENABLE_UART = "1"
#SERIAL_CONSOLE = "115200 ttyUSB0"
# RPI_EXTRA_CONFIG:append = " gpio=17=ip,pu "
```

## meta-msm/conf/layer.conf
```bitbake
# We have a conf and classes directory, add to BBPATH
BBPATH .= ":${LAYERDIR}"

# We have recipes-* directories, add to BBFILES
BBFILES += "${LAYERDIR}/recipes-*/*/*.bb \
            ${LAYERDIR}/recipes-*/*/*.bbappend"

BBFILE_COLLECTIONS += "meta-msm"
BBFILE_PATTERN_meta-msm = "^${LAYERDIR}/"
BBFILE_PRIORITY_meta-msm = "6"

LAYERDEPENDS_meta-msm = "core"
LAYERSERIES_COMPAT_meta-msm = "kirkstone"

#ENABLE_UART = "1"
#IMAGE_INSTALL:append = " openssh"
```
